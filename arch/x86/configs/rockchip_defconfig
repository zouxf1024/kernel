## drivers/bluetooth/ublox/Kconfig
```kconfig
config EMMY_BT8XXX_SDIO
	bool

config EMMY_BT8XXX
	tristate "Ubox bluetooth sdio driver"
	select EMMY_BT8XXX_SDIO
	depends on !(BT_MRVL || BT_MRVL_SDIO)
	---help---
	  EVK-EMMY-W1 BT driver
```

## drivers/net/ethernet/rockchip/Kconfig
```kconfig
#
# rockchip device configuration
#

config NET_VENDOR_ROCKCHIP
        bool "Rockchip devices"
        default y
        depends on HAS_IOMEM
        select AT803X_PHY
        select DAVICOM_PHY
        select SMSC_PHY
        select ICPLUS_PHY
        select REALTEK_PHY
        select NATIONAL_PHY
	---help---
	  Rockchip devices

if NET_VENDOR_ROCKCHIP

source "drivers/net/ethernet/rockchip/vmac/Kconfig"

endif # NET_VENDOR_ROCKCHIP
```

## drivers/net/wireless/ublox/Kconfig
```kconfig
config EMMY_MLAN_SDIO
	tristate

config EMMY_SD8XXX
	tristate

config EMMY_MLAN
	tristate "Ublox EMMY-MLAN"
	select EMMY_MLAN_SDIO
	select EMMY_SD8XXX
	depends on !(MWIFIEX || MWIFIEX_SDIO)
	---help---
	  EVK-EMMY-W1 WIFI driver
```

## drivers/staging/rtl8188eus_rtl/Kconfig
```kconfig
config RTL8188EU
	tristate "Realtek 8188E USB WiFi"
	select WIRELESS_EXT
	select WEXT_PRIV
	select CFG80211
	depends on USB
	---help---
	  Help message of RTL8188EU
```

## drivers/staging/rtl8821au/Kconfig
```kconfig
config RTL8821AU
	tristate "Realtek 8821A USB WiFi"
	depends on USB && WLAN
	select WIRELESS_EXT
	select WEXT_PRIV
	select CFG80211
	# select IEEE80211
	default n

	---help---
	  Help message of RTL8821AU
```
